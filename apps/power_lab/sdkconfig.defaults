## apps/power_lab/sdkconfig.defaults
```kconfig
# power_lab 工程差异项(共享默认值见 ../../sdkconfig.platform)
CONFIG_PARTITION_TABLE_CUSTOM_FILENAME="../../partitions.csv"

# CPU 锁频负载项(esp_pm_configure,见 main/power_lab_ctl.c)。只本工程开启,不进共享
# sdkconfig.platform——CONFIG_PM_ENABLE 有运行时开销(中断延迟增加),其它评估 app/游戏
# 不需要为它多付这个代价。
#
# Confirmed via espressif-docs MCP + $IDF_PATH/components/esp_pm/Kconfig(esp-idf v6.0
# 本地源码交叉核对):CONFIG_PM_ENABLE 的可选条件是 `!FREERTOS_SMP && SOC_PM_SUPPORTED`
# (本仓 FREERTOS_SMP 默认关闭,esp32 经典款 SOC_PM_SUPPORTED=y,可选)。CONFIG_PM_DFS_INIT_AUTO
# 默认关闭,意味着开 CONFIG_PM_ENABLE 本身**不会**自动启动动态调频——运行时状态完全由本
# app 主动调用 esp_pm_configure() 决定,不影响开机默认行为。
#
# 本 app 的 CPU 锁频矩阵项刻意只在 max/min 频率间切换、**不开 light_sleep_enable**
# (esp_pm_config_t.light_sleep_enable 恒为 false,见 power_lab_ctl.c apply_cpu_mode),
# 因此不需要额外开 CONFIG_FREERTOS_USE_TICKLESS_IDLE——那是自动轻睡眠专属的前置条件
# (Kconfig 帮助文本 + pm_impl.c 源码均确认:esp_pm_configure 只在
# config->light_sleep_enable=true 且 CONFIG_FREERTOS_USE_TICKLESS_IDLE 未开时才返回
# ESP_ERR_NOT_SUPPORTED)。不开自动轻睡眠也避开了经典 ESP32 + PSRAM 组合下 light sleep
# 期间 PSRAM CS 引脚漏电流需要额外 Kconfig(CONFIG_ESP_SLEEP_PSRAM_LEAKAGE_WORKAROUND)
# 兜底的那一整套配置面,查证结论见 apps/power_lab/README.md「CPU 锁频查证结论」。
CONFIG_PM_ENABLE=y
```

## apps/slingshot_feed/sdkconfig.defaults
```kconfig
# slingshot_feed 工程差异项(共享默认值见 ../../sdkconfig.platform)
CONFIG_PARTITION_TABLE_CUSTOM_FILENAME="../../partitions.csv"
```

## apps/tilt_maze/sdkconfig.defaults
```kconfig
# tilt_maze 工程差异项(共享默认值见 ../../sdkconfig.platform,由工程 CMakeLists 一并引入)

# 分区表在仓库根(所有工程共用同一份;路径相对本工程目录)
CONFIG_PARTITION_TABLE_CUSTOM_FILENAME="../../partitions.csv"
```

## components/bsp_core2/Kconfig
```kconfig
menu "Core2 BSP (板载能力裁剪)"

    comment "电源(AXP192)/内部 I2C / IMU 为平台必选,不可关"

    config BSP_ENABLE_LEDS
        bool "SK6812 灯条 (Bottom2, G25 ×10)"
        default y

    config BSP_ENABLE_AUDIO
        bool "NS4168 I2S 扬声器"
        default y

    config BSP_ENABLE_DISPLAY
        bool "ILI9342C LCD (320×240)"
        default y

    config BSP_ENABLE_TOUCH
        bool "FT6336U 电容触摸 (未上板验证)"
        depends on BSP_ENABLE_DISPLAY
        default y

endmenu
```

## sdkconfig.defaults
```kconfig
# ── 平台固定(Core2 v1.0 = 经典 ESP32 LX6,不是 S3)──────────────────────────
CONFIG_IDF_TARGET="esp32"

# Core2 板载 16MB flash
CONFIG_ESPTOOLPY_FLASHSIZE_16MB=y

# 自定义分区表:16MB flash 给 factory 3M + storage 2M(放音频/图片素材)
CONFIG_PARTITION_TABLE_CUSTOM=y
CONFIG_PARTITION_TABLE_CUSTOM_FILENAME="partitions.csv"

# PSRAM 默认关:多数幼儿应用内部 RAM 够用,开 PSRAM 反而引入经典 ESP32 的
# cache bug 变通与 >4MB himem 限制(见 docs/platform/Core2_v1_0.md §1)。
# 需要大帧缓冲(整屏 double buffer 等)时再打开下面两行:
# CONFIG_SPIRAM=y
# CONFIG_SPIRAM_MALLOC_ALWAYSINTERNAL=4096

# 1kHz tick:音频/IMU 任务需要较细调度粒度(默认 100Hz 太粗)
CONFIG_FREERTOS_HZ=1000

# 给 app_main 多一点栈(bsp_init 序列 + 日志)
CONFIG_ESP_MAIN_TASK_STACK_SIZE=4096
```
