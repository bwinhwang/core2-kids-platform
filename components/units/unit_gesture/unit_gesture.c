#include "unit_gesture.h"

#include "esp_log.h"

static const char *TAG = "unit_gesture";

#define REG_BANK_SEL        0xEF
#define REG_PART_ID_LOW     0x00
#define REG_PART_ID_HIGH    0x01
#define REG_RESULT_0        0x43   // bank0:8 个方向/旋转手势位
#define REG_RESULT_1        0x44   // bank0:bit0 = 快速挥手(Wave)

#define PART_ID_LOW_EXPECT   0x20
#define PART_ID_HIGH_EXPECT  0x76

#define I2C_SPEED_HZ    100000
#define I2C_TIMEOUT_MS  50

static i2c_master_dev_handle_t s_dev;

// 出厂初始化表(bank0 + bank1,219 组 {reg,val})—— 逐字节核实自 DFRobot_PAJ7620U2
// 参考驱动(见头文件注释的来源说明),严禁手改数值。
static const uint8_t s_init_regs[219][2] = {
    {0xEF,0x00},
    {0x32,0x29}, {0x33,0x01}, {0x34,0x00}, {0x35,0x01}, {0x36,0x00},
    {0x37,0x07}, {0x38,0x17}, {0x39,0x06}, {0x3A,0x12}, {0x3F,0x00},
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    {0x76,0x31}, {0x77,0x01}, {0x7C,0x84}, {0x7D,0x03}, {0x7E,0x01},
};

static esp_err_t write_reg(uint8_t reg, uint8_t val)
{
    uint8_t buf[2] = { reg, val };
    return i2c_master_transmit(s_dev, buf, 2, I2C_TIMEOUT_MS);
}

// 两笔独立事务:先写寄存器号(STOP),再单独发起读 —— 不用 i2c_master_transmit_receive
// (repeated-start 组合读)。PAJ7620U2 是硬件寄存器 ASIC 本可组合读,但平台惯例
// "拿不准/无需省一次事务时一律走保守两笔"(docs/units/_MCU_Firmware_I2C_Units.md),
// 与 unit_dlight/unit_ultrasonic 一致。
static esp_err_t read_regs(uint8_t reg, uint8_t *buf, size_t n)
{
    esp_err_t err = i2c_master_transmit(s_dev, &reg, 1, I2C_TIMEOUT_MS);
    if (err != ESP_OK) return err;
    return i2c_master_receive(s_dev, buf, n, I2C_TIMEOUT_MS);
}

static esp_err_t select_bank(uint8_t bank)
{
    return write_reg(REG_BANK_SEL, bank);
}

esp_err_t unit_gesture_init(i2c_master_bus_handle_t bus, uint8_t addr)
{
    if (!bus) return ESP_ERR_INVALID_ARG;
    if (addr == 0) addr = UNIT_GESTURE_ADDR_DEFAULT;

    if (!s_dev) {
        i2c_device_config_t dev_cfg = {
            .dev_addr_length = I2C_ADDR_BIT_LEN_7,
            .device_address  = addr,
            .scl_speed_hz    = I2C_SPEED_HZ,
        };
        esp_err_t err = i2c_master_bus_add_device(bus, &dev_cfg, &s_dev);
        if (err != ESP_OK) {
            ESP_LOGE(TAG, "i2c_master_bus_add_device 失败: %s", esp_err_to_name(err));
            return err;
        }
    }

    esp_err_t err = select_bank(0);
    if (err != ESP_OK) {
        ESP_LOGW(TAG, "Gesture 无响应(%s):总线异常——线缆/供电(M-Bus 5V/EXTEN)?",
                 esp_err_to_name(err));
        return err;
    }

    uint8_t id[2];
    err = read_regs(REG_PART_ID_LOW, id, 2);
    if (err != ESP_OK) {
        ESP_LOGW(TAG, "Gesture PART ID 读失败(%s)", esp_err_to_name(err));
        return err;
    }
    if (id[0] != PART_ID_LOW_EXPECT || id[1] != PART_ID_HIGH_EXPECT) {
        ESP_LOGW(TAG, "Gesture PART ID 不符(got %02X%02X,期望 %02X%02X)",
                 id[1], id[0], PART_ID_HIGH_EXPECT, PART_ID_LOW_EXPECT);
        return ESP_ERR_NOT_FOUND;
    }

    // 灌出厂初始化表(表内已含一次 bank0→bank1 切换),完成后显式切回 bank0
    // 供后续手势结果寄存器(0x43/0x44,均在 bank0)读取。
    for (size_t i = 0; i < sizeof(s_init_regs) / sizeof(s_init_regs[0]); i++) {
        err = write_reg(s_init_regs[i][0], s_init_regs[i][1]);
        if (err != ESP_OK) {
            ESP_LOGW(TAG, "Gesture 初始化表写入失败于第 %d 项(%s)", (int)i, esp_err_to_name(err));
            return err;
        }
    }
    err = select_bank(0);
    if (err != ESP_OK) return err;

    ESP_LOGI(TAG, "Gesture 就绪 @0x%02X(9 手势模式)", addr);
    return ESP_OK;
}

esp_err_t unit_gesture_read(gesture_event_t *out)
{
    if (!s_dev) return ESP_ERR_INVALID_STATE;
    if (!out)   return ESP_ERR_INVALID_ARG;

    uint8_t flag[2];
    esp_err_t err = read_regs(REG_RESULT_0, flag, 2);   // 0x43 + 0x44 一并收(自增地址)
    if (err != ESP_OK) return err;

    if (flag[1] & 0x01) {
        *out = GESTURE_WAVE;
        return ESP_OK;
    }

    // 比特位映射定案见头文件注释(采用 DFRobot_PAJ7620U2,与 M5Stack 官方例程一致)
    switch (flag[0]) {
        case 0x01: *out = GESTURE_RIGHT;            break;
        case 0x02: *out = GESTURE_LEFT;              break;
        case 0x04: *out = GESTURE_UP;                break;
        case 0x08: *out = GESTURE_DOWN;              break;
        case 0x10: *out = GESTURE_FORWARD;           break;
        case 0x20: *out = GESTURE_BACKWARD;          break;
        case 0x40: *out = GESTURE_CLOCKWISE;         break;
        case 0x80: *out = GESTURE_COUNTER_CLOCKWISE; break;
        default:   *out = GESTURE_NONE;              break;   // 0 或多位同时置位(罕见过渡态)
    }
    return ESP_OK;
}
